## CMakeLists.txt
```
cmake_minimum_required(VERSION 3.20.0)

list(APPEND ZEPHYR_EXTRA_MODULES ${CMAKE_CURRENT_LIST_DIR}/../../..)
find_package(Zephyr REQUIRED HINTS $ENV{ZEPHYR_BASE})
project(agisostack_zephyr_minimal)

target_sources(app PRIVATE src/main.cpp)
target_link_libraries(app PRIVATE Isobus HardwareIntegration Utility)
```

## prj.conf
```kconfig
CONFIG_CPP=y
CONFIG_REQUIRES_FULL_LIBCPP=y
CONFIG_THREAD_NAME=y
CONFIG_THREAD_STACK_INFO=y
CONFIG_THREAD_MONITOR=y
CONFIG_INIT_STACKS=y
CONFIG_NUM_PREEMPT_PRIORITIES=56
CONFIG_CMSIS_RTOS_V2=y
CONFIG_CMSIS_V2_THREAD_DYNAMIC_MAX_COUNT=2
CONFIG_CMSIS_V2_THREAD_DYNAMIC_STACK_SIZE=4096
CONFIG_CMSIS_V2_THREAD_MAX_STACK_SIZE=4096
CONFIG_MAIN_STACK_SIZE=4096
CONFIG_HEAP_MEM_POOL_SIZE=16384
CONFIG_AGISOSTACK_CMSIS_RTOS2_THREADING=y
```

## src/main.cpp
```c
#include "isobus/hardware_integration/can_hardware_interface.hpp"
#include "isobus/utility/system_timing.hpp"
#include "isobus/zephyr/time_source.hpp"

#include <zephyr/kernel.h>

#ifdef CONFIG_BOARD_NATIVE_SIM
#include <posix_board_if.h>
#endif

static int finish(int result)
{
#ifdef CONFIG_BOARD_NATIVE_SIM
	posix_exit(result);
#endif
	return result;
}

int main()
{
	static isobus::ZephyrTimeSource timeSource;
	isobus::SystemTiming::override_time_source(&timeSource);

	if (!isobus::CANHardwareInterface::start() || !isobus::CANHardwareInterface::is_running())
	{
		printk("AgIsoStack++ startup failed\n");
		return finish(1);
	}

	printk("AgIsoStack++ started\n");
	k_msleep(10);
	if (!isobus::CANHardwareInterface::stop())
	{
		printk("AgIsoStack++ shutdown failed\n");
		return finish(1);
	}
	printk("AgIsoStack++ stopped\n");
	return finish(0);
}
```
